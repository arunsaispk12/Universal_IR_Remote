## sdkconfig.defaults
```kconfig
# ESP32/ESP32-S3 Multi-Target Configuration
# Target is set via 'idf.py set-target <target>' command
# Do not hardcode CONFIG_IDF_TARGET here - it will be set automatically

# Flash Configuration (4MB default - adjust in menuconfig for 8MB/16MB)
CONFIG_ESPTOOLPY_FLASHSIZE_4MB=y
CONFIG_ESPTOOLPY_FLASHSIZE="4MB"
CONFIG_ESPTOOLPY_FLASHFREQ_40M=y
CONFIG_ESPTOOLPY_FLASHMODE_DIO=y

# Partition Table
CONFIG_PARTITION_TABLE_CUSTOM=y
CONFIG_PARTITION_TABLE_CUSTOM_FILENAME="partitions.csv"
CONFIG_PARTITION_TABLE_FILENAME="partitions.csv"

# Bluetooth & BLE
CONFIG_BT_ENABLED=y
CONFIG_BT_BLUEDROID_ENABLED=y
CONFIG_BT_BLE_ENABLED=y
CONFIG_BT_BLE_42_FEATURES_SUPPORTED=y
CONFIG_BT_NIMBLE_ENABLED=n
CONFIG_BT_CONTROLLER_ENABLED=y

# WiFi
CONFIG_ESP_WIFI_STATIC_RX_BUFFER_NUM=10
CONFIG_ESP_WIFI_DYNAMIC_RX_BUFFER_NUM=32
CONFIG_ESP_WIFI_DYNAMIC_TX_BUFFER_NUM=32

# ESP RainMaker
# Use Self Claiming (gets MQTT credentials directly from claiming service)
CONFIG_ESP_RMAKER_SELF_CLAIM=y
CONFIG_ESP_RMAKER_ASSISTED_CLAIM=n
# Disable challenge response to avoid conflict with self claiming
CONFIG_ESP_RMAKER_ENABLE_CHALLENGE_RESPONSE=n

# FreeRTOS Stack Sizes
CONFIG_ESP_MAIN_TASK_STACK_SIZE=6144
CONFIG_ESP_SYSTEM_EVENT_TASK_STACK_SIZE=4096
CONFIG_FREERTOS_IDLE_TASK_STACKSIZE=2048
CONFIG_PTHREAD_TASK_STACK_SIZE_DEFAULT=3072

# Bluetooth Stack Sizes
CONFIG_BT_BTC_TASK_STACK_SIZE=4096
CONFIG_BT_BTU_TASK_STACK_SIZE=4096

# LWIP
CONFIG_LWIP_TCPIP_TASK_STACK_SIZE=3072

# Compiler Options
CONFIG_COMPILER_OPTIMIZATION_SIZE=y

# Logging
CONFIG_LOG_DEFAULT_LEVEL_INFO=y
CONFIG_LOG_MAXIMUM_LEVEL_VERBOSE=y

# Application Manager
CONFIG_APP_RETRIEVE_LEN_ELF_SHA=16

# Security
CONFIG_SECURE_BOOT=n
CONFIG_SECURE_FLASH_ENC_ENABLED=n
```

## sdkconfig.defaults.bak
```kconfig
# ESP32 Configuration
CONFIG_IDF_TARGET="esp32"
CONFIG_IDF_TARGET_ESP32=y

# Flash Configuration (4MB)
CONFIG_ESPTOOLPY_FLASHSIZE_4MB=y
CONFIG_ESPTOOLPY_FLASHSIZE="4MB"
CONFIG_ESPTOOLPY_FLASHFREQ_40M=y
CONFIG_ESPTOOLPY_FLASHMODE_DIO=y

# Partition Table
CONFIG_PARTITION_TABLE_CUSTOM=y
CONFIG_PARTITION_TABLE_CUSTOM_FILENAME="partitions.csv"
CONFIG_PARTITION_TABLE_FILENAME="partitions.csv"

# Bluetooth & BLE
CONFIG_BT_ENABLED=y
CONFIG_BT_BLUEDROID_ENABLED=y
CONFIG_BT_BLE_ENABLED=y
CONFIG_BT_BLE_42_FEATURES_SUPPORTED=y
CONFIG_BT_NIMBLE_ENABLED=n
CONFIG_BT_CONTROLLER_ENABLED=y

# WiFi
CONFIG_ESP_WIFI_STATIC_RX_BUFFER_NUM=10
CONFIG_ESP_WIFI_DYNAMIC_RX_BUFFER_NUM=32
CONFIG_ESP_WIFI_DYNAMIC_TX_BUFFER_NUM=32

# ESP RainMaker
CONFIG_ESP_RMAKER_SELF_CLAIM=y
CONFIG_ESP_RMAKER_CLAIM_TYPE=1
CONFIG_ESP_RMAKER_ASSISTED_CLAIM=n

# FreeRTOS Stack Sizes
CONFIG_ESP_MAIN_TASK_STACK_SIZE=6144
CONFIG_ESP_SYSTEM_EVENT_TASK_STACK_SIZE=4096
CONFIG_FREERTOS_IDLE_TASK_STACKSIZE=2048
CONFIG_PTHREAD_TASK_STACK_SIZE_DEFAULT=3072

# Bluetooth Stack Sizes
CONFIG_BT_BTC_TASK_STACK_SIZE=4096
CONFIG_BT_BTU_TASK_STACK_SIZE=4096

# LWIP
CONFIG_LWIP_TCPIP_TASK_STACK_SIZE=3072

# Compiler Options
CONFIG_COMPILER_OPTIMIZATION_SIZE=y

# Logging
CONFIG_LOG_DEFAULT_LEVEL_INFO=y
CONFIG_LOG_MAXIMUM_LEVEL_VERBOSE=y

# Application Manager
CONFIG_APP_RETRIEVE_LEN_ELF_SHA=16

# Security
CONFIG_SECURE_BOOT=n
CONFIG_SECURE_FLASH_ENC_ENABLED=n
```
